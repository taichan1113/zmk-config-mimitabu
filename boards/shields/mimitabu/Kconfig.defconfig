## boards/shields/mimitabu/Kconfig.defconfig
```kconfig
if SHIELD_MIMITABU

config ZMK_KEYBOARD_NAME
    default "MIMITABU"

config SPI
	default y
endif
```

## config/west.yml
```yaml
manifest:
  remotes:
    - name: zmkfirmware
      url-base: https://github.com/zmkfirmware
    - name: badjeff
      url-base: https://github.com/badjeff
    - name: caksoylar
      url-base: https://github.com/caksoylar 
    - name: BP
      url-base: https://github.com/taichan1113
  projects:
    - name: zmk
      remote: zmkfirmware
      revision: v0.3
      import: app/west.yml
    - name: zmk-pmw3610-driver
      remote: badjeff
      revision: zmk-0.3
    - name: zmk-rgbled-widget
      remote: caksoylar
      revision: v0.3-branch
    - name: zmk-behavior-sensor-attr-cycle
      remote: badjeff
      revision: main
    - name: zmk-input-motion-pwm
      remote: BP
      revision: main
  self:
    path: config
```
